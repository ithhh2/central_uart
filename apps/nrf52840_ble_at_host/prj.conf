## CMakeLists.txt
```
# SPDX-License-Identifier: Apache-2.0

cmake_minimum_required(VERSION 3.20.0)
find_package(Zephyr REQUIRED HINTS $ENV{ZEPHYR_BASE})
project(nrf52840_ble_at_host)

include(${ZEPHYR_BASE}/samples/subsys/usb/common/common.cmake)
target_sources(app PRIVATE
	src/app_common.c
	src/at_host.c
	src/main.c
	src/profile_manager.c
	src/settings.c
)
```

## prj.conf
```kconfig
CONFIG_USB_DEVICE_STACK_NEXT=y

CONFIG_STDOUT_CONSOLE=y
CONFIG_SERIAL=y
CONFIG_UART_LINE_CTRL=y
CONFIG_UART_INTERRUPT_DRIVEN=y
CONFIG_USBD_CDC_ACM_CLASS=y
CONFIG_CDC_ACM_SERIAL_INITIALIZE_AT_BOOT=n
CONFIG_CONSOLE=y
CONFIG_PRINTK=y

CONFIG_LOG=n
CONFIG_MAIN_STACK_SIZE=4096
CONFIG_SYSTEM_WORKQUEUE_STACK_SIZE=4096

CONFIG_BT=y
CONFIG_BT_CENTRAL=y
CONFIG_BT_OBSERVER=y
CONFIG_BT_SCAN=y
CONFIG_BT_GATT_CLIENT=y
CONFIG_BT_GATT_AUTO_DISCOVER_CCC=y
CONFIG_BT_PHY_UPDATE=y
CONFIG_BT_USER_PHY_UPDATE=y
CONFIG_BT_DATA_LEN_UPDATE=y
CONFIG_BT_USER_DATA_LEN_UPDATE=y
CONFIG_BT_DEVICE_NAME="nRF52840 BLE AT Host"
CONFIG_BT_MAX_CONN=1
CONFIG_BT_MAX_PAIRED=0
CONFIG_BT_SMP=y
CONFIG_BT_SETTINGS=n
CONFIG_BT_PRIVACY=y
CONFIG_HEAP_MEM_POOL_SIZE=2048
CONFIG_BT_L2CAP_TX_MTU=259
CONFIG_BT_BUF_ACL_RX_SIZE=263
CONFIG_BT_BUF_ACL_TX_SIZE=263

CONFIG_FLASH=y
CONFIG_FLASH_MAP=y
CONFIG_NVS=y
CONFIG_SETTINGS=y
CONFIG_SETTINGS_NVS=y
CONFIG_MPU_ALLOW_FLASH_WRITE=y

CONFIG_SAMPLE_USBD_VID=0x2FE3
CONFIG_SAMPLE_USBD_PID=0x0001
CONFIG_SAMPLE_USBD_PRODUCT="nRF52840 BLE AT Host"
```

## src/app_common.c
```c
#include "app_common.h"

#include <ctype.h>
#include <stdio.h>
#include <string.h>

static bool is_hex_text(const char *text, size_t len)
{
	for (size_t i = 0; i < len; ++i) {
		if (!isxdigit((unsigned char)text[i])) {
			return false;
		}
	}

	return true;
}

static bool normalize_uuid16(const char *text, char *output, size_t output_len)
{
	char digits[5];
	size_t offset = 0U;
	size_t len = strlen(text);

	if (len >= 2U && text[0] == '0' && (text[1] == 'x' || text[1] == 'X')) {
		offset = 2U;
		len -= 2U;
	}

	if (len != 4U || !is_hex_text(text + offset, len) || output_len < 7U) {
		return false;
	}

	memcpy(digits, text + offset, 4U);
	digits[4] = '\0';
	snprintk(output, output_len, "0x%c%c%c%c",
		 (char)toupper((unsigned char)digits[0]),
		 (char)toupper((unsigned char)digits[1]),
		 (char)toupper((unsigned char)digits[2]),
		 (char)toupper((unsigned char)digits[3]));
	return true;
}

static bool normalize_uuid128_from_hex32(const char *hex32, char *output, size_t output_len)
{
	if (strlen(hex32) != 32U || !is_hex_text(hex32, 32U) || output_len < 37U) {
		return false;
	}

	snprintk(output, output_len,
		 "%c%c%c%c%c%c%c%c-%c%c%c%c-%c%c%c%c-%c%c%c%c-%c%c%c%c%c%c%c%c%c%c%c%c",
		 (char)tolower((unsigned char)hex32[0]), (char)tolower((unsigned char)hex32[1]),
		 (char)tolower((unsigned char)hex32[2]), (char)tolower((unsigned char)hex32[3]),
		 (char)tolower((unsigned char)hex32[4]), (char)tolower((unsigned char)hex32[5]),
		 (char)tolower((unsigned char)hex32[6]), (char)tolower((unsigned char)hex32[7]),
		 (char)tolower((unsigned char)hex32[8]), (char)tolower((unsigned char)hex32[9]),
		 (char)tolower((unsigned char)hex32[10]), (char)tolower((unsigned char)hex32[11]),
		 (char)tolower((unsigned char)hex32[12]), (char)tolower((unsigned char)hex32[13]),
		 (char)tolower((unsigned char)hex32[14]), (char)tolower((unsigned char)hex32[15]),
		 (char)tolower((unsigned char)hex32[16]), (char)tolower((unsigned char)hex32[17]),
		 (char)tolower((unsigned char)hex32[18]), (char)tolower((unsigned char)hex32[19]),
		 (char)tolower((unsigned char)hex32[20]), (char)tolower((unsigned char)hex32[21]),
		 (char)tolower((unsigned char)hex32[22]), (char)tolower((unsigned char)hex32[23]),
		 (char)tolower((unsigned char)hex32[24]), (char)tolower((unsigned char)hex32[25]),
		 (char)tolower((unsigned char)hex32[26]), (char)tolower((unsigned char)hex32[27]),
		 (char)tolower((unsigned char)hex32[28]), (char)tolower((unsigned char)hex32[29]),
		 (char)tolower((unsigned char)hex32[30]), (char)tolower((unsigned char)hex32[31]));
	return true;
}

bool ble_host_normalize_uuid(const char *input, char *output, size_t output_len)
{
	char compact[33];
	size_t compact_len = 0U;
	size_t len;

	if (input == NULL || output == NULL || output_len == 0U) {
		return false;
	}

	while (*input != '\0' && isspace((unsigned char)*input)) {
		input++;
	}

	len = strlen(input);
	while (len > 0U && isspace((unsigned char)input[len - 1U])) {
		len--;
	}

	if (len == 0U) {
		return false;
	}

	if (len <= 6U && normalize_uuid16(input, output, output_len)) {
		return true;
	}

	for (size_t i = 0; i < len; ++i) {
		unsigned char ch = (unsigned char)input[i];

		if (ch == '-') {
			continue;
		}

		if (!isxdigit(ch) || compact_len >= sizeof(compact) - 1U) {
			return false;
		}

		compact[compact_len++] = (char)ch;
	}

	compact[compact_len] = '\0';
	if (compact_len != 32U) {
		return false;
	}

	return normalize_uuid128_from_hex32(compact, output, output_len);
}

void ble_host_format_uuid_from_bt(const struct bt_uuid *uuid, char *output, size_t output_len)
{
	char raw[BT_UUID_STR_LEN];

	if (uuid == NULL || output == NULL || output_len == 0U) {
		return;
	}

	bt_uuid_to_str(uuid, raw, sizeof(raw));
	if (!ble_host_normalize_uuid(raw, output, output_len)) {
		snprintk(output, output_len, "%s", raw);
	}
}

bool ble_host_uuid_equals(const char *lhs, const char *rhs)
{
	char lhs_norm[BLE_HOST_UUID_STR_LEN];
	char rhs_norm[BLE_HOST_UUID_STR_LEN];

	if (!ble_host_normalize_uuid(lhs, lhs_norm, sizeof(lhs_norm)) ||
	    !ble_host_normalize_uuid(rhs, rhs_norm, sizeof(rhs_norm))) {
		return false;
	}

	return strcmp(lhs_norm, rhs_norm) == 0;
}

uint8_t ble_host_addr_type_to_wlt(uint8_t bt_addr_type)
{
	switch (bt_addr_type) {
	case BT_ADDR_LE_PUBLIC:
		return 0U;
	case BT_ADDR_LE_RANDOM:
		return 1U;
	case BT_ADDR_LE_PUBLIC_ID:
		return 2U;
	case BT_ADDR_LE_RANDOM_ID:
		return 3U;
	default:
		return 1U;
	}
}

bool ble_host_addr_type_from_wlt(uint8_t wlt_addr_type, uint8_t *bt_addr_type)
{
	if (bt_addr_type == NULL) {
		return false;
	}

	switch (wlt_addr_type) {
	case 0U:
		*bt_addr_type = BT_ADDR_LE_PUBLIC;
		return true;
	case 1U:
		*bt_addr_type = BT_ADDR_LE_RANDOM;
		return true;
	case 2U:
		*bt_addr_type = BT_ADDR_LE_PUBLIC_ID;
		return true;
	case 3U:
		*bt_addr_type = BT_ADDR_LE_RANDOM_ID;
		return true;
	default:
		return false;
	}
}

bool ble_host_is_printable_ascii(const uint8_t *data, size_t len)
{
	if (data == NULL) {
		return false;
	}

	for (size_t i = 0; i < len; ++i) {
		if (data[i] < 0x20U || data[i] > 0x7eU) {
			return false;
		}
	}

	return true;
}
```

## src/app_common.h
```c
#ifndef NRF52840_BLE_AT_HOST_APP_COMMON_H_
#define NRF52840_BLE_AT_HOST_APP_COMMON_H_

#include <stdbool.h>
#include <stddef.h>
#include <stdint.h>

#include <zephyr/bluetooth/addr.h>
#include <zephyr/bluetooth/uuid.h>

#define BLE_HOST_UUID_STR_LEN BT_UUID_STR_LEN
#define BLE_HOST_NAME_MAX_LEN 32
#define BLE_HOST_SCAN_FILTER_MAX_LEN 32
#define BLE_HOST_SEND_MAX_LEN 256

struct ble_profile {
	char service_uuid[BLE_HOST_UUID_STR_LEN];
	char notify_uuid[BLE_HOST_UUID_STR_LEN];
	char write_uuid[BLE_HOST_UUID_STR_LEN];
};

struct ble_host_config {
	struct ble_profile active_profile;
	uint16_t mtu;
	uint16_t conn_interval_min;
	uint16_t conn_interval_max;
	uint16_t latency;
	uint16_t timeout;
	bool auto_mtu;
	bool auto_subscribe;
	bool prefer_2m_phy;
	bool prefer_dle;
	bool allow_data_mode;
	uint16_t stream_guard_time_ms;
};

struct ble_host_status {
	bool connected;
	bool ready;
	char mac[BT_ADDR_LE_STR_LEN];
	uint8_t conn_count;
	uint16_t data_len;
};

struct ble_stream_stats {
	uint32_t bytes_host_to_ble;
	uint32_t bytes_ble_to_host;
	uint32_t write_ops;
	uint32_t notify_ops;
	uint32_t usb_backpressure_count;
	uint32_t max_host_to_ble_depth;
	uint32_t max_ble_to_host_depth;
	uint32_t enter_data_mode_count;
	uint32_t unexpected_disconnect_count;
};

bool ble_host_normalize_uuid(const char *input, char *output, size_t output_len);
void ble_host_format_uuid_from_bt(const struct bt_uuid *uuid, char *output, size_t output_len);
bool ble_host_uuid_equals(const char *lhs, const char *rhs);
uint8_t ble_host_addr_type_to_wlt(uint8_t bt_addr_type);
bool ble_host_addr_type_from_wlt(uint8_t wlt_addr_type, uint8_t *bt_addr_type);
bool ble_host_is_printable_ascii(const uint8_t *data, size_t len);

#endif
```

## src/at_host.c
```c
#include "at_host.h"

#include <ctype.h>
#include <errno.h>
#include <stdbool.h>
#include <stdio.h>
#include <stdlib.h>
#include <string.h>

#include <zephyr/sys/util.h>

enum at_error_kind {
	AT_ERROR_INVALID_COMMAND = 0,
	AT_ERROR_INVALID_PARAMETERS,
	AT_ERROR_FUNCTION_ERROR,
};

enum at_command_result {
	AT_COMMAND_RESULT_NONE = 0,
	AT_COMMAND_RESULT_ENTER_PAYLOAD,
};

struct at_host_state {
	const struct at_host_ops *ops;
	const struct at_host_tx *tx;
	void *context;
	char line_buffer[160];
	size_t line_length;
	bool line_overflow;
	bool payload_mode;
	uint8_t payload_buffer[BLE_HOST_SEND_MAX_LEN];
	size_t payload_expected;
	size_t payload_received;
	uint8_t payload_conn_index;
};

static struct at_host_state g_state;

static bool equals_ignore_case(const char *lhs, const char *rhs)
{
	while (*lhs != '\0' && *rhs != '\0') {
		if (toupper((unsigned char)*lhs) != toupper((unsigned char)*rhs)) {
			return false;
		}

		lhs++;
		rhs++;
	}

	return *lhs == '\0' && *rhs == '\0';
}

static bool starts_with_ignore_case(const char *text, const char *prefix)
{
	while (*prefix != '\0') {
		if (*text == '\0' ||
		    toupper((unsigned char)*text) != toupper((unsigned char)*prefix)) {
			return false;
		}

		text++;
		prefix++;
	}

	return true;
}

static void tx_line(const char *line)
{
	if (g_state.tx != NULL && g_state.tx->line != NULL) {
		g_state.tx->line(g_state.context, line);
	}
}

static void tx_raw(const uint8_t *data, size_t len)
{
	if (g_state.tx != NULL && g_state.tx->raw != NULL) {
		g_state.tx->raw(g_state.context, data, len);
	}
}

static void emit_error(enum at_error_kind error_kind)
{
	switch (error_kind) {
	case AT_ERROR_INVALID_COMMAND:
		tx_line("+ERR=Invalid Command");
		return;
	case AT_ERROR_INVALID_PARAMETERS:
		tx_line("+ERR=Invalid Parameters");
		return;
	default:
		tx_line("+ERR=Function Error");
		return;
	}
}

static void emit_error_from_errno(int err)
{
	if (err == -EINVAL || err == -ENOENT || err == -ERANGE || err == -EMSGSIZE) {
		emit_error(AT_ERROR_INVALID_PARAMETERS);
		return;
	}

	emit_error(AT_ERROR_FUNCTION_ERROR);
}

static void trim_whitespace(char *text)
{
	size_t len = strlen(text);
	size_t start = 0U;

	while (start < len && isspace((unsigned char)text[start])) {
		start++;
	}

	while (len > start && isspace((unsigned char)text[len - 1U])) {
		len--;
	}

	if (start > 0U) {
		memmove(text, &text[start], len - start);
	}

	text[len - start] = '\0';
}

static bool parse_uint16_value(const char *text, uint16_t *value)
{
	char *end = NULL;
	unsigned long parsed;

	if (text == NULL || value == NULL || *text == '\0') {
		return false;
	}

	parsed = strtoul(text, &end, 10);
	if (end == text || *end != '\0' || parsed > UINT16_MAX) {
		return false;
	}

	*value = (uint16_t)parsed;
	return true;
}

static bool split_args(char *text, char **args, size_t max_args, size_t *arg_count)
{
	size_t count = 0U;
	char *cursor = text;

	if (text == NULL || args == NULL || arg_count == NULL) {
		return false;
	}

	while (cursor != NULL && *cursor != '\0' && count < max_args) {
		args[count++] = cursor;
		cursor = strchr(cursor, ',');
		if (cursor == NULL) {
			break;
		}

		*cursor = '\0';
		cursor++;
	}

	*arg_count = count;
	return true;
}

static void process_send_payload(void)
{
	int err;

	err = g_state.ops->send_payload(g_state.context, g_state.payload_conn_index,
					g_state.payload_buffer, g_state.payload_expected);
	g_state.payload_mode = false;
	g_state.payload_expected = 0U;
	g_state.payload_received = 0U;

	if (err) {
		emit_error_from_errno(err);
		return;
	}

	tx_line("+OK");
}

static void handle_get_status(void)
{
	struct ble_host_status status = {0};
	char line[80];

	g_state.ops->get_status(g_state.context, &status);
	if (!status.connected) {
		tx_line("+OK=NUM,0");
		return;
	}

	snprintk(line, sizeof(line), "0:%s,0,1,%u", status.mac, status.data_len);
	tx_line(line);
	tx_line("+OK=NUM,1");
}

static void handle_get_profile(void)
{
	struct ble_profile profile;
	char line[128];

	memset(&profile, 0, sizeof(profile));
	g_state.ops->get_profile(g_state.context, &profile);
	snprintk(line, sizeof(line), "+OK=%s,%s,%s",
		 profile.service_uuid, profile.notify_uuid, profile.write_uuid);
	tx_line(line);
}

static void handle_get_mtu(void)
{
	char line[32];
	uint16_t mtu = g_state.ops->get_mtu(g_state.context);

	snprintk(line, sizeof(line), "+OK=%u", mtu);
	tx_line(line);
}

static void handle_get_stream_stats(void)
{
	struct ble_stream_stats stats = {0};
	char line[192];

	if (g_state.ops == NULL || g_state.ops->get_stream_stats == NULL) {
		emit_error(AT_ERROR_FUNCTION_ERROR);
		return;
	}

	g_state.ops->get_stream_stats(g_state.context, &stats);
	snprintk(line, sizeof(line),
		 "+OK=H2B,%u,B2H,%u,WOP,%u,NOP,%u,BP,%u,MAXTX,%u,MAXRX,%u,ENT,%u,UDISC,%u",
		 stats.bytes_host_to_ble, stats.bytes_ble_to_host, stats.write_ops,
		 stats.notify_ops, stats.usb_backpressure_count, stats.max_host_to_ble_depth,
		 stats.max_ble_to_host_depth, stats.enter_data_mode_count,
		 stats.unexpected_disconnect_count);
	tx_line(line);
}

static enum at_command_result process_command(char *line)
{
	char working[160];
	char *args[5];
	size_t arg_count = 0U;
	int err;
	uint16_t u16_value;

	snprintk(working, sizeof(working), "%s", line);
	trim_whitespace(working);
	if (working[0] == '\0') {
		return AT_COMMAND_RESULT_NONE;
	}

	if (equals_ignore_case(working, "AT")) {
		tx_line("+OK");
		return AT_COMMAND_RESULT_NONE;
	}

	if (starts_with_ignore_case(working, "AT+STARTSCAN=")) {
		char *payload = working + strlen("AT+STARTSCAN=");
		char *filter_name = NULL;

		if (!split_args(payload, args, ARRAY_SIZE(args), &arg_count) || arg_count == 0U) {
			emit_error(AT_ERROR_INVALID_PARAMETERS);
			return AT_COMMAND_RESULT_NONE;
		}

		if (!parse_uint16_value(args[0], &u16_value) || u16_value == 0U) {
			emit_error(AT_ERROR_INVALID_PARAMETERS);
			return AT_COMMAND_RESULT_NONE;
		}

		if (arg_count >= 2U && args[1][0] != '\0') {
			filter_name = args[1];
		}

		err = g_state.ops->start_scan(g_state.context, u16_value, filter_name);
		if (err) {
			emit_error_from_errno(err);
			return AT_COMMAND_RESULT_NONE;
		}

		tx_line("+OK");
		return AT_COMMAND_RESULT_NONE;
	}

	if (starts_with_ignore_case(working, "AT+STARTCON=")) {
		char *payload = working + strlen("AT+STARTCON=");
		uint16_t addr_type;

		if (!split_args(payload, args, ARRAY_SIZE(args), &arg_count) || arg_count != 2U) {
			emit_error(AT_ERROR_INVALID_PARAMETERS);
			return AT_COMMAND_RESULT_NONE;
		}

		if (!parse_uint16_value(args[1], &addr_type) || addr_type > 3U) {
			emit_error(AT_ERROR_INVALID_PARAMETERS);
			return AT_COMMAND_RESULT_NONE;
		}

		err = g_state.ops->connect(g_state.context, args[0], (uint8_t)addr_type);
		if (err) {
			emit_error_from_errno(err);
			return AT_COMMAND_RESULT_NONE;
		}

		tx_line("+OK");
		return AT_COMMAND_RESULT_NONE;
	}

	if (starts_with_ignore_case(working, "AT+DISCON=")) {
		char *payload = working + strlen("AT+DISCON=");

		if (!parse_uint16_value(payload, &u16_value) || u16_value > 255U) {
			emit_error(AT_ERROR_INVALID_PARAMETERS);
			return AT_COMMAND_RESULT_NONE;
		}

		err = g_state.ops->disconnect(g_state.context, (uint8_t)u16_value);
		if (err) {
			emit_error_from_errno(err);
			return AT_COMMAND_RESULT_NONE;
		}

		tx_line("+OK");
		return AT_COMMAND_RESULT_NONE;
	}

	if (starts_with_ignore_case(working, "AT+SEND=")) {
		char *payload = working + strlen("AT+SEND=");
		uint16_t conn_index;

		if (!split_args(payload, args, ARRAY_SIZE(args), &arg_count) || arg_count != 2U) {
			emit_error(AT_ERROR_INVALID_PARAMETERS);
			return AT_COMMAND_RESULT_NONE;
		}

		if (!parse_uint16_value(args[0], &conn_index) ||
		    !parse_uint16_value(args[1], &u16_value) ||
		    conn_index > 255U || u16_value == 0U || u16_value > BLE_HOST_SEND_MAX_LEN) {
			emit_error(AT_ERROR_INVALID_PARAMETERS);
			return AT_COMMAND_RESULT_NONE;
		}

		g_state.payload_mode = true;
		g_state.payload_expected = u16_value;
		g_state.payload_received = 0U;
		g_state.payload_conn_index = (uint8_t)conn_index;
		tx_raw((const uint8_t *)">", 1U);
		return AT_COMMAND_RESULT_ENTER_PAYLOAD;
	}

	if (equals_ignore_case(working, "AT+CONSTATUS")) {
		handle_get_status();
		return AT_COMMAND_RESULT_NONE;
	}

	if (starts_with_ignore_case(working, "AT+SETSVCUUID=")) {
		char *payload = working + strlen("AT+SETSVCUUID=");

		if (!split_args(payload, args, ARRAY_SIZE(args), &arg_count) || arg_count != 3U) {
			emit_error(AT_ERROR_INVALID_PARAMETERS);
			return AT_COMMAND_RESULT_NONE;
		}

		err = g_state.ops->set_profile(g_state.context, args[0], args[1], args[2]);
		if (err) {
			emit_error_from_errno(err);
			return AT_COMMAND_RESULT_NONE;
		}

		tx_line("+OK");
		return AT_COMMAND_RESULT_NONE;
	}

	if (equals_ignore_case(working, "AT+GETSVCUUID")) {
		handle_get_profile();
		return AT_COMMAND_RESULT_NONE;
	}

	if (starts_with_ignore_case(working, "AT+SETMTU=")) {
		char *payload = working + strlen("AT+SETMTU=");

		if (!parse_uint16_value(payload, &u16_value)) {
			emit_error(AT_ERROR_INVALID_PARAMETERS);
			return AT_COMMAND_RESULT_NONE;
		}

		err = g_state.ops->set_mtu(g_state.context, u16_value);
		if (err) {
			emit_error_from_errno(err);
			return AT_COMMAND_RESULT_NONE;
		}

		tx_line("+OK");
		return AT_COMMAND_RESULT_NONE;
	}

	if (equals_ignore_case(working, "AT+GETMTU")) {
		handle_get_mtu();
		return AT_COMMAND_RESULT_NONE;
	}

	if (starts_with_ignore_case(working, "AT+CONMTUREQ=")) {
		char *payload = working + strlen("AT+CONMTUREQ=");

		if (!parse_uint16_value(payload, &u16_value) || u16_value > 255U) {
			emit_error(AT_ERROR_INVALID_PARAMETERS);
			return AT_COMMAND_RESULT_NONE;
		}

		err = g_state.ops->request_mtu(g_state.context, (uint8_t)u16_value);
		if (err) {
			emit_error_from_errno(err);
			return AT_COMMAND_RESULT_NONE;
		}

		tx_line("+OK");
		return AT_COMMAND_RESULT_NONE;
	}

	if (starts_with_ignore_case(working, "AT+CONPARAREQ=")) {
		char *payload = working + strlen("AT+CONPARAREQ=");
		uint16_t conn_index;
		uint16_t min_interval;
		uint16_t max_interval;
		uint16_t latency;
		uint16_t timeout;

		if (!split_args(payload, args, ARRAY_SIZE(args), &arg_count) || arg_count != 5U) {
			emit_error(AT_ERROR_INVALID_PARAMETERS);
			return AT_COMMAND_RESULT_NONE;
		}

		if (!parse_uint16_value(args[0], &conn_index) ||
		    !parse_uint16_value(args[1], &min_interval) ||
		    !parse_uint16_value(args[2], &max_interval) ||
		    !parse_uint16_value(args[3], &latency) ||
		    !parse_uint16_value(args[4], &timeout) ||
		    conn_index > 255U) {
			emit_error(AT_ERROR_INVALID_PARAMETERS);
			return AT_COMMAND_RESULT_NONE;
		}

		err = g_state.ops->set_conn_params(g_state.context, (uint8_t)conn_index,
						   min_interval, max_interval, latency, timeout);
		if (err) {
			emit_error_from_errno(err);
			return AT_COMMAND_RESULT_NONE;
		}

		tx_line("+OK");
		return AT_COMMAND_RESULT_NONE;
	}

	if (starts_with_ignore_case(working, "AT+ENTERDATAMODE=")) {
		char *payload = working + strlen("AT+ENTERDATAMODE=");

		if (!parse_uint16_value(payload, &u16_value) || u16_value > 255U ||
		    g_state.ops == NULL || g_state.ops->enter_data_mode == NULL) {
			emit_error(AT_ERROR_INVALID_PARAMETERS);
			return AT_COMMAND_RESULT_NONE;
		}

		err = g_state.ops->enter_data_mode(g_state.context, (uint8_t)u16_value);
		if (err) {
			emit_error_from_errno(err);
			return AT_COMMAND_RESULT_NONE;
		}

		tx_line("+OK");
		tx_line("+IND=DATAMODE,1");
		return AT_COMMAND_RESULT_NONE;
	}

	if (equals_ignore_case(working, "AT+STREAMSTAT")) {
		handle_get_stream_stats();
		return AT_COMMAND_RESULT_NONE;
	}

	if (starts_with_ignore_case(working, "AT+")) {
		emit_error(AT_ERROR_FUNCTION_ERROR);
		return AT_COMMAND_RESULT_NONE;
	}

	emit_error(AT_ERROR_INVALID_COMMAND);
	return AT_COMMAND_RESULT_NONE;
}

void at_host_init(const struct at_host_ops *ops, const struct at_host_tx *tx, void *context)
{
	memset(&g_state, 0, sizeof(g_state));
	g_state.ops = ops;
	g_state.tx = tx;
	g_state.context = context;
}

void at_host_rx_bytes(const uint8_t *data, size_t len)
{
	bool skip_payload_line_ending = false;

	for (size_t i = 0; i < len; ++i) {
		uint8_t ch = data[i];

		if (g_state.payload_mode) {
			if (skip_payload_line_ending && g_state.payload_received == 0U &&
			    (ch == '\r' || ch == '\n')) {
				continue;
			}

			skip_payload_line_ending = false;
			g_state.payload_buffer[g_state.payload_received++] = ch;
			if (g_state.payload_received == g_state.payload_expected) {
				process_send_payload();
			}
			continue;
		}

		if (ch == '\r' || ch == '\n') {
			if (!g_state.line_overflow && g_state.line_length > 0U) {
				enum at_command_result result;

				g_state.line_buffer[g_state.line_length] = '\0';
				result = process_command(g_state.line_buffer);
				skip_payload_line_ending = (result == AT_COMMAND_RESULT_ENTER_PAYLOAD);
			} else if (g_state.line_overflow) {
				emit_error(AT_ERROR_INVALID_COMMAND);
			}

			g_state.line_length = 0U;
			g_state.line_overflow = false;
			continue;
		}

		if (g_state.line_length >= sizeof(g_state.line_buffer) - 1U) {
			g_state.line_overflow = true;
			continue;
		}

		g_state.line_buffer[g_state.line_length++] = (char)ch;
	}
}

void at_host_notify_scan_result(uint8_t index, const char *mac, const char *name,
				uint8_t addr_type, int8_t rssi)
{
	char line[128];

	snprintk(line, sizeof(line), "+IND=SCDA,%u,%s,%s,%u,%d",
		 index, mac, name != NULL ? name : "", addr_type, rssi);
	tx_line(line);
}

void at_host_notify_scan_complete(void)
{
	tx_line("+IND=SCED");
}

void at_host_notify_connected(void)
{
	tx_line("+IND=BLMC,0");
}

void at_host_notify_disconnected(void)
{
	tx_line("+IND=BLMD,0");
}

void at_host_notify_ready(void)
{
	tx_line("+IND=BLMN,0");
}

void at_host_notify_mtu(uint16_t payload_len)
{
	char line[32];

	snprintk(line, sizeof(line), "+IND=MTU,%u", payload_len);
	tx_line(line);
}

void at_host_notify_receive(const uint8_t *data, uint16_t len)
{
	char line[BLE_HOST_SEND_MAX_LEN + 32];

	if (!ble_host_is_printable_ascii(data, len) || len > BLE_HOST_SEND_MAX_LEN) {
		/*
		 * Control mode only exposes printable WLT8016-style text payloads.
		 * Binary notify traffic can continue briefly after leaving data mode;
		 * drop it silently so the AT control plane stays usable.
		 */
		return;
	}

	snprintk(line, sizeof(line), "+IND=RECV,0,%u,%.*s", len, len, data);
	tx_line(line);
}

void at_host_notify_link_params(uint16_t interval, uint16_t latency, uint16_t timeout)
{
	char line[64];

	snprintk(line, sizeof(line), "+IND=LINKPARA,0,%u,%u,%u", interval, latency, timeout);
	tx_line(line);
}

void at_host_notify_data_mode(bool enabled)
{
	tx_line(enabled ? "+IND=DATAMODE,1" : "+IND=DATAMODE,0");
}

void at_host_notify_function_error(void)
{
	emit_error(AT_ERROR_FUNCTION_ERROR);
}
```

## src/at_host.h
```c
#ifndef NRF52840_BLE_AT_HOST_AT_HOST_H_
#define NRF52840_BLE_AT_HOST_AT_HOST_H_

#include <stdbool.h>
#include <stddef.h>
#include <stdint.h>

#include "app_common.h"

struct at_host_ops {
	int (*start_scan)(void *context, uint16_t duration_s, const char *filter_name);
	int (*connect)(void *context, const char *mac, uint8_t addr_type);
	int (*disconnect)(void *context, uint8_t conn_index);
	int (*send_payload)(void *context, uint8_t conn_index, const uint8_t *data, size_t len);
	void (*get_status)(void *context, struct ble_host_status *status);
	void (*get_profile)(void *context, struct ble_profile *profile);
	int (*set_profile)(void *context, const char *service_uuid, const char *notify_uuid,
			   const char *write_uuid);
	int (*set_mtu)(void *context, uint16_t mtu);
	uint16_t (*get_mtu)(void *context);
	int (*request_mtu)(void *context, uint8_t conn_index);
	int (*set_conn_params)(void *context, uint8_t conn_index, uint16_t min_interval,
			       uint16_t max_interval, uint16_t latency, uint16_t timeout);
	int (*enter_data_mode)(void *context, uint8_t conn_index);
	void (*get_stream_stats)(void *context, struct ble_stream_stats *stats);
};

struct at_host_tx {
	void (*line)(void *context, const char *line);
	void (*raw)(void *context, const uint8_t *data, size_t len);
};

void at_host_init(const struct at_host_ops *ops, const struct at_host_tx *tx, void *context);
void at_host_rx_bytes(const uint8_t *data, size_t len);
void at_host_notify_scan_result(uint8_t index, const char *mac, const char *name,
				uint8_t addr_type, int8_t rssi);
void at_host_notify_scan_complete(void);
void at_host_notify_connected(void);
void at_host_notify_disconnected(void);
void at_host_notify_ready(void);
void at_host_notify_mtu(uint16_t payload_len);
void at_host_notify_receive(const uint8_t *data, uint16_t len);
void at_host_notify_link_params(uint16_t interval, uint16_t latency, uint16_t timeout);
void at_host_notify_data_mode(bool enabled);
void at_host_notify_function_error(void);

#endif
```

## src/profile_manager.c
```c
#include "profile_manager.h"

#include <string.h>

#include <zephyr/bluetooth/conn.h>
#include <zephyr/bluetooth/gatt.h>
#include <zephyr/bluetooth/hci.h>
#include <zephyr/sys/util.h>

#include "app_common.h"

struct profile_manager_state {
	const struct ble_host_config *config;
	const struct profile_manager_callbacks *callbacks;
	void *context;
	struct bt_conn *conn;
	struct bt_gatt_discover_params service_discover_params;
	struct bt_gatt_discover_params characteristic_discover_params;
	struct bt_gatt_discover_params ccc_discover_params;
	struct bt_gatt_subscribe_params subscribe_params;
	struct bt_gatt_exchange_params exchange_params;
	struct bt_gatt_write_params write_params;
	uint16_t service_start_handle;
	uint16_t service_end_handle;
	uint16_t notify_value_handle;
	uint16_t write_value_handle;
	uint8_t write_properties;
	bool ready;
	bool service_found;
	bool notify_found;
	bool write_found;
	bool exchange_in_progress;
	bool write_in_progress;
	uint16_t payload_len;
	uint8_t pending_write[BLE_HOST_SEND_MAX_LEN];
	size_t pending_write_len;
};

static struct profile_manager_state g_state;

static void report_error(enum profile_manager_error error)
{
	if (g_state.callbacks != NULL && g_state.callbacks->error != NULL) {
		g_state.callbacks->error(g_state.context, error);
	}
}

static void update_payload_len(void)
{
	uint16_t att_mtu = 23U;
	uint16_t preferred = 23U;

	if (g_state.conn != NULL) {
		att_mtu = bt_gatt_get_mtu(g_state.conn);
	}

	if (g_state.config != NULL) {
		preferred = g_state.config->mtu;
	}

	if (preferred < 23U) {
		preferred = 23U;
	}

	att_mtu = MIN(att_mtu, preferred);
	g_state.payload_len = att_mtu > 3U ? (uint16_t)(att_mtu - 3U) : 20U;
}

static uint8_t notify_handler(struct bt_conn *conn, struct bt_gatt_subscribe_params *params,
			      const void *data, uint16_t length)
{
	ARG_UNUSED(conn);
	ARG_UNUSED(params);

	if (data == NULL) {
		g_state.ready = false;
		return BT_GATT_ITER_STOP;
	}

	if (g_state.callbacks != NULL && g_state.callbacks->payload_received != NULL) {
		g_state.callbacks->payload_received(g_state.context, data, length);
	}

	return BT_GATT_ITER_CONTINUE;
}

static void subscribe_handler(struct bt_conn *conn, uint8_t err,
			      struct bt_gatt_subscribe_params *params)
{
	ARG_UNUSED(conn);
	ARG_UNUSED(params);

	if (err != 0U) {
		g_state.ready = false;
		report_error(PROFILE_MANAGER_ERROR_SUBSCRIBE_FAILED);
		return;
	}

	g_state.ready = true;
	if (g_state.callbacks != NULL && g_state.callbacks->ready != NULL) {
		g_state.callbacks->ready(g_state.context);
	}
}

static int subscribe_notify_characteristic(void)
{
	int err;

	memset(&g_state.subscribe_params, 0, sizeof(g_state.subscribe_params));
	g_state.subscribe_params.value_handle = g_state.notify_value_handle;
	g_state.subscribe_params.ccc_handle = BT_GATT_AUTO_DISCOVER_CCC_HANDLE;
	g_state.subscribe_params.end_handle = g_state.service_end_handle;
	g_state.subscribe_params.disc_params = &g_state.ccc_discover_params;
	g_state.subscribe_params.value = BT_GATT_CCC_NOTIFY;
	g_state.subscribe_params.notify = notify_handler;
	g_state.subscribe_params.subscribe = subscribe_handler;

	err = bt_gatt_subscribe(g_state.conn, &g_state.subscribe_params);
	if (err) {
		report_error(PROFILE_MANAGER_ERROR_SUBSCRIBE_FAILED);
		return err;
	}

	return 0;
}

static uint8_t characteristic_discover_cb(struct bt_conn *conn,
					  const struct bt_gatt_attr *attr,
					  struct bt_gatt_discover_params *params)
{
	char uuid_text[BLE_HOST_UUID_STR_LEN];

	ARG_UNUSED(conn);
	ARG_UNUSED(params);

	if (attr == NULL) {
		if (!g_state.notify_found) {
			report_error(PROFILE_MANAGER_ERROR_NOTIFY_MISSING);
			return BT_GATT_ITER_STOP;
		}

		if (!g_state.write_found) {
			report_error(PROFILE_MANAGER_ERROR_WRITE_MISSING);
			return BT_GATT_ITER_STOP;
		}

		if (g_state.config != NULL && g_state.config->auto_subscribe) {
			(void)subscribe_notify_characteristic();
		} else {
			g_state.ready = true;
			if (g_state.callbacks != NULL && g_state.callbacks->ready != NULL) {
				g_state.callbacks->ready(g_state.context);
			}
		}

		return BT_GATT_ITER_STOP;
	}

	if (params->type != BT_GATT_DISCOVER_CHARACTERISTIC) {
		report_error(PROFILE_MANAGER_ERROR_DISCOVER_FAILED);
		return BT_GATT_ITER_STOP;
	}

	const struct bt_gatt_chrc *chrc = attr->user_data;

	ble_host_format_uuid_from_bt(chrc->uuid, uuid_text, sizeof(uuid_text));
	if (!g_state.notify_found &&
	    ble_host_uuid_equals(uuid_text, g_state.config->active_profile.notify_uuid)) {
		g_state.notify_found = true;
		g_state.notify_value_handle = chrc->value_handle;
	}

	if (!g_state.write_found &&
	    ble_host_uuid_equals(uuid_text, g_state.config->active_profile.write_uuid)) {
		g_state.write_found = true;
		g_state.write_value_handle = chrc->value_handle;
		g_state.write_properties = chrc->properties;
	}

	return BT_GATT_ITER_CONTINUE;
}

static int start_characteristic_discovery(void)
{
	int err;

	memset(&g_state.characteristic_discover_params, 0, sizeof(g_state.characteristic_discover_params));
	g_state.characteristic_discover_params.uuid = NULL;
	g_state.characteristic_discover_params.func = characteristic_discover_cb;
	g_state.characteristic_discover_params.start_handle = g_state.service_start_handle;
	g_state.characteristic_discover_params.end_handle = g_state.service_end_handle;
	g_state.characteristic_discover_params.type = BT_GATT_DISCOVER_CHARACTERISTIC;

	err = bt_gatt_discover(g_state.conn, &g_state.characteristic_discover_params);
	if (err) {
		report_error(PROFILE_MANAGER_ERROR_DISCOVER_FAILED);
	}

	return err;
}

static uint8_t service_discover_cb(struct bt_conn *conn, const struct bt_gatt_attr *attr,
				   struct bt_gatt_discover_params *params)
{
	char uuid_text[BLE_HOST_UUID_STR_LEN];

	ARG_UNUSED(conn);
	ARG_UNUSED(params);

	if (attr == NULL) {
		if (!g_state.service_found) {
			report_error(PROFILE_MANAGER_ERROR_SERVICE_MISSING);
			return BT_GATT_ITER_STOP;
		}

		(void)start_characteristic_discovery();
		return BT_GATT_ITER_STOP;
	}

	if (params->type != BT_GATT_DISCOVER_PRIMARY) {
		report_error(PROFILE_MANAGER_ERROR_DISCOVER_FAILED);
		return BT_GATT_ITER_STOP;
	}

	const struct bt_gatt_service_val *service = attr->user_data;

	ble_host_format_uuid_from_bt(service->uuid, uuid_text, sizeof(uuid_text));
	if (ble_host_uuid_equals(uuid_text, g_state.config->active_profile.service_uuid)) {
		g_state.service_found = true;
		g_state.service_start_handle = attr->handle;
		g_state.service_end_handle = service->end_handle;
	}

	return BT_GATT_ITER_CONTINUE;
}

static void exchange_handler(struct bt_conn *conn, uint8_t err,
			     struct bt_gatt_exchange_params *params)
{
	ARG_UNUSED(conn);

	g_state.exchange_in_progress = false;
	__ASSERT_NO_MSG(params == &g_state.exchange_params);

	if (err == 0U || err == BT_ATT_ERR_SUCCESS) {
		update_payload_len();
		if (g_state.callbacks != NULL && g_state.callbacks->mtu_updated != NULL) {
			g_state.callbacks->mtu_updated(g_state.context, g_state.payload_len);
		}
	}

	memset(params, 0, sizeof(*params));
}

static void write_handler(struct bt_conn *conn, uint8_t err,
			  struct bt_gatt_write_params *params)
{
	ARG_UNUSED(conn);
	ARG_UNUSED(params);

	g_state.write_in_progress = false;
	if (err != 0U) {
		report_error(PROFILE_MANAGER_ERROR_WRITE_FAILED);
	}
}

void profile_manager_init(const struct ble_host_config *config,
			  const struct profile_manager_callbacks *callbacks, void *context)
{
	memset(&g_state, 0, sizeof(g_state));
	g_state.config = config;
	g_state.callbacks = callbacks;
	g_state.context = context;
	update_payload_len();
}

void profile_manager_set_config(const struct ble_host_config *config)
{
	g_state.config = config;
	update_payload_len();
}

void profile_manager_reset(void)
{
	if (g_state.conn != NULL) {
		(void)bt_gatt_unsubscribe(g_state.conn, &g_state.subscribe_params);
	}

	memset(&g_state.service_discover_params, 0, sizeof(g_state.service_discover_params));
	memset(&g_state.characteristic_discover_params, 0, sizeof(g_state.characteristic_discover_params));
	memset(&g_state.ccc_discover_params, 0, sizeof(g_state.ccc_discover_params));
	memset(&g_state.subscribe_params, 0, sizeof(g_state.subscribe_params));
	memset(&g_state.exchange_params, 0, sizeof(g_state.exchange_params));
	memset(&g_state.write_params, 0, sizeof(g_state.write_params));
	g_state.service_start_handle = 0U;
	g_state.service_end_handle = 0U;
	g_state.notify_value_handle = 0U;
	g_state.write_value_handle = 0U;
	g_state.write_properties = 0U;
	g_state.ready = false;
	g_state.service_found = false;
	g_state.notify_found = false;
	g_state.write_found = false;
	g_state.exchange_in_progress = false;
	g_state.write_in_progress = false;
	g_state.pending_write_len = 0U;
	update_payload_len();
}

int profile_manager_start(struct bt_conn *conn)
{
	int err;

	if (conn == NULL || g_state.config == NULL) {
		return -EINVAL;
	}

	profile_manager_reset();
	g_state.conn = conn;
	update_payload_len();

	memset(&g_state.service_discover_params, 0, sizeof(g_state.service_discover_params));
	g_state.service_discover_params.uuid = NULL;
	g_state.service_discover_params.func = service_discover_cb;
	g_state.service_discover_params.start_handle = BT_ATT_FIRST_ATTRIBUTE_HANDLE;
	g_state.service_discover_params.end_handle = BT_ATT_LAST_ATTRIBUTE_HANDLE;
	g_state.service_discover_params.type = BT_GATT_DISCOVER_PRIMARY;

	err = bt_gatt_discover(g_state.conn, &g_state.service_discover_params);
	if (err) {
		report_error(PROFILE_MANAGER_ERROR_DISCOVER_FAILED);
	}

	return err;
}

void profile_manager_handle_disconnected(struct bt_conn *conn)
{
	if (g_state.conn == conn) {
		profile_manager_reset();
		g_state.conn = NULL;
	}
}

int profile_manager_request_mtu(void)
{
	int err;

	if (g_state.conn == NULL) {
		return -ENOTCONN;
	}

	if (g_state.exchange_in_progress) {
		return -EBUSY;
	}

	g_state.exchange_params.func = exchange_handler;
	g_state.exchange_in_progress = true;

	err = bt_gatt_exchange_mtu(g_state.conn, &g_state.exchange_params);
	if (err == -EALREADY) {
		g_state.exchange_in_progress = false;
		memset(&g_state.exchange_params, 0, sizeof(g_state.exchange_params));
		update_payload_len();
		if (g_state.callbacks != NULL && g_state.callbacks->mtu_updated != NULL) {
			g_state.callbacks->mtu_updated(g_state.context, g_state.payload_len);
		}
		return 0;
	}

	if (err) {
		g_state.exchange_in_progress = false;
		memset(&g_state.exchange_params, 0, sizeof(g_state.exchange_params));
		return err;
	}

	return 0;
}

int profile_manager_request_data_len(void)
{
	if (g_state.conn == NULL) {
		return -ENOTCONN;
	}

	if (!IS_ENABLED(CONFIG_BT_USER_DATA_LEN_UPDATE)) {
		return -ENOTSUP;
	}

	return bt_conn_le_data_len_update(g_state.conn, BT_LE_DATA_LEN_PARAM_MAX);
}

int profile_manager_request_phy(void)
{
	if (g_state.conn == NULL) {
		return -ENOTCONN;
	}

	if (!IS_ENABLED(CONFIG_BT_USER_PHY_UPDATE)) {
		return -ENOTSUP;
	}

	return bt_conn_le_phy_update(g_state.conn, BT_CONN_LE_PHY_PARAM_2M);
}

int profile_manager_send(const uint8_t *data, size_t len)
{
	int err;

	if (g_state.conn == NULL) {
		return -ENOTCONN;
	}

	if (!g_state.ready || !g_state.write_found || g_state.write_value_handle == 0U) {
		return -EAGAIN;
	}

	if (len == 0U || len > BLE_HOST_SEND_MAX_LEN || len > g_state.payload_len) {
		return -EMSGSIZE;
	}

	if (g_state.write_properties & BT_GATT_CHRC_WRITE_WITHOUT_RESP) {
		return bt_gatt_write_without_response(g_state.conn, g_state.write_value_handle, data, len,
						      false);
	}

	if ((g_state.write_properties & BT_GATT_CHRC_WRITE) == 0U || g_state.write_in_progress) {
		return -EACCES;
	}

	memcpy(g_state.pending_write, data, len);
	g_state.pending_write_len = len;
	memset(&g_state.write_params, 0, sizeof(g_state.write_params));
	g_state.write_params.func = write_handler;
	g_state.write_params.handle = g_state.write_value_handle;
	g_state.write_params.offset = 0U;
	g_state.write_params.data = g_state.pending_write;
	g_state.write_params.length = g_state.pending_write_len;
	g_state.write_in_progress = true;

	err = bt_gatt_write(g_state.conn, &g_state.write_params);
	if (err) {
		g_state.write_in_progress = false;
	}

	return err;
}

bool profile_manager_is_ready(void)
{
	return g_state.ready;
}

bool profile_manager_can_enter_data_mode(void)
{
	return g_state.ready &&
	       g_state.write_found &&
	       g_state.write_value_handle != 0U &&
	       (g_state.write_properties & BT_GATT_CHRC_WRITE_WITHOUT_RESP) != 0U;
}

uint16_t profile_manager_get_payload_len(void)
{
	return g_state.payload_len;
}
```

## src/profile_manager.h
```c
#ifndef NRF52840_BLE_AT_HOST_PROFILE_MANAGER_H_
#define NRF52840_BLE_AT_HOST_PROFILE_MANAGER_H_

#include <stdbool.h>
#include <stddef.h>
#include <stdint.h>

#include <zephyr/bluetooth/conn.h>

#include "app_common.h"

enum profile_manager_error {
	PROFILE_MANAGER_ERROR_SERVICE_MISSING = 0,
	PROFILE_MANAGER_ERROR_NOTIFY_MISSING,
	PROFILE_MANAGER_ERROR_WRITE_MISSING,
	PROFILE_MANAGER_ERROR_DISCOVER_FAILED,
	PROFILE_MANAGER_ERROR_SUBSCRIBE_FAILED,
	PROFILE_MANAGER_ERROR_WRITE_FAILED,
};

struct profile_manager_callbacks {
	void (*ready)(void *context);
	void (*payload_received)(void *context, const uint8_t *data, uint16_t len);
	void (*mtu_updated)(void *context, uint16_t payload_len);
	void (*error)(void *context, enum profile_manager_error error);
};

void profile_manager_init(const struct ble_host_config *config,
			  const struct profile_manager_callbacks *callbacks, void *context);
void profile_manager_set_config(const struct ble_host_config *config);
void profile_manager_reset(void);
int profile_manager_start(struct bt_conn *conn);
void profile_manager_handle_disconnected(struct bt_conn *conn);
int profile_manager_request_mtu(void);
int profile_manager_request_data_len(void);
int profile_manager_request_phy(void);
int profile_manager_send(const uint8_t *data, size_t len);
bool profile_manager_is_ready(void);
bool profile_manager_can_enter_data_mode(void);
uint16_t profile_manager_get_payload_len(void);

#endif
```

## src/settings.c
```c
#include "settings.h"

#include <errno.h>
#include <string.h>

#include <zephyr/settings/settings.h>
#include <zephyr/sys/printk.h>
#include <zephyr/sys/util.h>

#define SETTINGS_ROOT "ble_at_host"
#define SETTINGS_KEY_SERVICE SETTINGS_ROOT "/profile/service_uuid"
#define SETTINGS_KEY_NOTIFY SETTINGS_ROOT "/profile/notify_uuid"
#define SETTINGS_KEY_WRITE SETTINGS_ROOT "/profile/write_uuid"
#define SETTINGS_KEY_MTU SETTINGS_ROOT "/mtu"
#define SETTINGS_KEY_CONN_MIN SETTINGS_ROOT "/conn_interval_min"
#define SETTINGS_KEY_CONN_MAX SETTINGS_ROOT "/conn_interval_max"
#define SETTINGS_KEY_LATENCY SETTINGS_ROOT "/latency"
#define SETTINGS_KEY_TIMEOUT SETTINGS_ROOT "/timeout"
#define SETTINGS_KEY_AUTO_MTU SETTINGS_ROOT "/auto_mtu"
#define SETTINGS_KEY_AUTO_SUBSCRIBE SETTINGS_ROOT "/auto_subscribe"
#define SETTINGS_KEY_PREFER_2M_PHY SETTINGS_ROOT "/prefer_2m_phy"
#define SETTINGS_KEY_PREFER_DLE SETTINGS_ROOT "/prefer_dle"
#define SETTINGS_KEY_ALLOW_DATA_MODE SETTINGS_ROOT "/allow_data_mode"
#define SETTINGS_KEY_STREAM_GUARD SETTINGS_ROOT "/stream_guard_time_ms"

static struct ble_host_config g_config = {
	.active_profile = {
		.service_uuid = "0xFFF0",
		.notify_uuid = "0xFFF1",
		.write_uuid = "0xFFF2",
	},
	.mtu = 259U,
	.conn_interval_min = 6U,
	.conn_interval_max = 9U,
	.latency = 0U,
	.timeout = 400U,
	.auto_mtu = true,
	.auto_subscribe = true,
	.prefer_2m_phy = true,
	.prefer_dle = true,
	.allow_data_mode = true,
	.stream_guard_time_ms = 1000U,
};

static int settings_handle_set(const char *name, size_t len, settings_read_cb read_cb, void *cb_arg)
{
	char text[BLE_HOST_UUID_STR_LEN];
	int rc;

	if (settings_name_steq(name, "profile/service_uuid", NULL)) {
		if (len == 0U || len >= sizeof(text)) {
			return -EINVAL;
		}

		rc = read_cb(cb_arg, text, len);
		if (rc < 0) {
			return rc;
		}

		text[len] = '\0';
		return ble_host_normalize_uuid(text, g_config.active_profile.service_uuid,
					       sizeof(g_config.active_profile.service_uuid)) ? 0 : -EINVAL;
	}

	if (settings_name_steq(name, "profile/notify_uuid", NULL)) {
		if (len == 0U || len >= sizeof(text)) {
			return -EINVAL;
		}

		rc = read_cb(cb_arg, text, len);
		if (rc < 0) {
			return rc;
		}

		text[len] = '\0';
		return ble_host_normalize_uuid(text, g_config.active_profile.notify_uuid,
					       sizeof(g_config.active_profile.notify_uuid)) ? 0 : -EINVAL;
	}

	if (settings_name_steq(name, "profile/write_uuid", NULL)) {
		if (len == 0U || len >= sizeof(text)) {
			return -EINVAL;
		}

		rc = read_cb(cb_arg, text, len);
		if (rc < 0) {
			return rc;
		}

		text[len] = '\0';
		return ble_host_normalize_uuid(text, g_config.active_profile.write_uuid,
					       sizeof(g_config.active_profile.write_uuid)) ? 0 : -EINVAL;
	}

	if (settings_name_steq(name, "mtu", NULL)) {
		return read_cb(cb_arg, &g_config.mtu, sizeof(g_config.mtu)) >= 0 ? 0 : -EINVAL;
	}

	if (settings_name_steq(name, "conn_interval_min", NULL)) {
		return read_cb(cb_arg, &g_config.conn_interval_min,
			       sizeof(g_config.conn_interval_min)) >= 0 ? 0 : -EINVAL;
	}

	if (settings_name_steq(name, "conn_interval_max", NULL)) {
		return read_cb(cb_arg, &g_config.conn_interval_max,
			       sizeof(g_config.conn_interval_max)) >= 0 ? 0 : -EINVAL;
	}

	if (settings_name_steq(name, "latency", NULL)) {
		return read_cb(cb_arg, &g_config.latency, sizeof(g_config.latency)) >= 0 ? 0 : -EINVAL;
	}

	if (settings_name_steq(name, "timeout", NULL)) {
		return read_cb(cb_arg, &g_config.timeout, sizeof(g_config.timeout)) >= 0 ? 0 : -EINVAL;
	}

	if (settings_name_steq(name, "auto_mtu", NULL)) {
		return read_cb(cb_arg, &g_config.auto_mtu, sizeof(g_config.auto_mtu)) >= 0 ? 0 : -EINVAL;
	}

	if (settings_name_steq(name, "auto_subscribe", NULL)) {
		return read_cb(cb_arg, &g_config.auto_subscribe,
			       sizeof(g_config.auto_subscribe)) >= 0 ? 0 : -EINVAL;
	}

	if (settings_name_steq(name, "prefer_2m_phy", NULL)) {
		return read_cb(cb_arg, &g_config.prefer_2m_phy,
			       sizeof(g_config.prefer_2m_phy)) >= 0 ? 0 : -EINVAL;
	}

	if (settings_name_steq(name, "prefer_dle", NULL)) {
		return read_cb(cb_arg, &g_config.prefer_dle,
			       sizeof(g_config.prefer_dle)) >= 0 ? 0 : -EINVAL;
	}

	if (settings_name_steq(name, "allow_data_mode", NULL)) {
		return read_cb(cb_arg, &g_config.allow_data_mode,
			       sizeof(g_config.allow_data_mode)) >= 0 ? 0 : -EINVAL;
	}

	if (settings_name_steq(name, "stream_guard_time_ms", NULL)) {
		return read_cb(cb_arg, &g_config.stream_guard_time_ms,
			       sizeof(g_config.stream_guard_time_ms)) >= 0 ? 0 : -EINVAL;
	}

	return -ENOENT;
}

SETTINGS_STATIC_HANDLER_DEFINE(ble_at_host_cfg, SETTINGS_ROOT, NULL, settings_handle_set, NULL, NULL);

static bool conn_params_valid(uint16_t min_interval, uint16_t max_interval,
			      uint16_t latency, uint16_t timeout)
{
	if (min_interval < 6U || min_interval > 800U) {
		return false;
	}

	if (max_interval < 6U || max_interval > 800U || min_interval > max_interval) {
		return false;
	}

	if (timeout == 0U) {
		return false;
	}

	ARG_UNUSED(latency);
	return true;
}

int ble_host_settings_init(void)
{
	int err;

	err = settings_subsys_init();
	if (err) {
		return err;
	}

	err = settings_load_subtree(SETTINGS_ROOT);
	if (err) {
		return err;
	}

	return 0;
}

const struct ble_host_config *ble_host_settings_get(void)
{
	return &g_config;
}

int ble_host_settings_update_profile(const char *service_uuid, const char *notify_uuid,
				     const char *write_uuid)
{
	char service_norm[BLE_HOST_UUID_STR_LEN];
	char notify_norm[BLE_HOST_UUID_STR_LEN];
	char write_norm[BLE_HOST_UUID_STR_LEN];
	int err;

	if (!ble_host_normalize_uuid(service_uuid, service_norm, sizeof(service_norm)) ||
	    !ble_host_normalize_uuid(notify_uuid, notify_norm, sizeof(notify_norm)) ||
	    !ble_host_normalize_uuid(write_uuid, write_norm, sizeof(write_norm))) {
		return -EINVAL;
	}

	snprintk(g_config.active_profile.service_uuid, sizeof(g_config.active_profile.service_uuid),
		 "%s", service_norm);
	snprintk(g_config.active_profile.notify_uuid, sizeof(g_config.active_profile.notify_uuid),
		 "%s", notify_norm);
	snprintk(g_config.active_profile.write_uuid, sizeof(g_config.active_profile.write_uuid),
		 "%s", write_norm);

	err = settings_save_one(SETTINGS_KEY_SERVICE, g_config.active_profile.service_uuid,
				strlen(g_config.active_profile.service_uuid));
	if (err) {
		return err;
	}

	err = settings_save_one(SETTINGS_KEY_NOTIFY, g_config.active_profile.notify_uuid,
				strlen(g_config.active_profile.notify_uuid));
	if (err) {
		return err;
	}

	return settings_save_one(SETTINGS_KEY_WRITE, g_config.active_profile.write_uuid,
				 strlen(g_config.active_profile.write_uuid));
}

int ble_host_settings_update_mtu(uint16_t mtu)
{
	if (mtu < 23U || mtu > 259U) {
		return -EINVAL;
	}

	g_config.mtu = mtu;
	return settings_save_one(SETTINGS_KEY_MTU, &g_config.mtu, sizeof(g_config.mtu));
}

int ble_host_settings_update_conn_params(uint16_t min_interval, uint16_t max_interval,
					 uint16_t latency, uint16_t timeout)
{
	int err;

	if (!conn_params_valid(min_interval, max_interval, latency, timeout)) {
		return -EINVAL;
	}

	g_config.conn_interval_min = min_interval;
	g_config.conn_interval_max = max_interval;
	g_config.latency = latency;
	g_config.timeout = timeout;

	err = settings_save_one(SETTINGS_KEY_CONN_MIN, &g_config.conn_interval_min,
				sizeof(g_config.conn_interval_min));
	if (err) {
		return err;
	}

	err = settings_save_one(SETTINGS_KEY_CONN_MAX, &g_config.conn_interval_max,
				sizeof(g_config.conn_interval_max));
	if (err) {
		return err;
	}

	err = settings_save_one(SETTINGS_KEY_LATENCY, &g_config.latency, sizeof(g_config.latency));
	if (err) {
		return err;
	}

	return settings_save_one(SETTINGS_KEY_TIMEOUT, &g_config.timeout, sizeof(g_config.timeout));
}
```

## src/settings.h
```c
#ifndef NRF52840_BLE_AT_HOST_SETTINGS_H_
#define NRF52840_BLE_AT_HOST_SETTINGS_H_

#include "app_common.h"

int ble_host_settings_init(void);
const struct ble_host_config *ble_host_settings_get(void);
int ble_host_settings_update_profile(const char *service_uuid, const char *notify_uuid,
				     const char *write_uuid);
int ble_host_settings_update_mtu(uint16_t mtu);
int ble_host_settings_update_conn_params(uint16_t min_interval, uint16_t max_interval,
					 uint16_t latency, uint16_t timeout);

#endif
```
